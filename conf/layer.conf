## conf/layer.conf
```bitbake
# We have a conf and classes directory, add to BBPATH
BBPATH .= ":${LAYERDIR}"

# We have a packages directory, add to BBFILES
BBFILES += "${LAYERDIR}/recipes-*/*/*.bb \
            ${LAYERDIR}/recipes-*/*/*.bbappend"

BBFILE_COLLECTIONS += "maselettronica-layer"
BBFILE_PATTERN_maselettronica-layer := "^${LAYERDIR}/"
BBFILE_PRIORITY_maselettronica-layer = "6"
LAYERSERIES_COMPAT_maselettronica-layer = "kirkstone langdale mickledore nanbield scarthgap"
LAYERDEPENDS_maselettronica-layer = "core"

MAS_DEFAULT_UBOOTTOOLS = "u-boot-mas-tools"
PREFERRED_PROVIDER_u-boot-tools-native = "${MAS_DEFAULT_UBOOTTOOLS}-native"
PREFERRED_PROVIDER_nativesdk-u-boot-tools = "nativesdk-${MAS_DEFAULT_UBOOTTOOLS}"
PREFERRED_PROVIDER_u-boot-mkimage-native = "${MAS_DEFAULT_UBOOTTOOLS}-native"
PREFERRED_PROVIDER_nativesdk-u-boot-mkimage = "nativesdk-${MAS_DEFAULT_UBOOTTOOLS}"
```

## conf/machine/imx91-jfn0937-usd.conf
```bitbake
#@TYPE: Machine
#@NAME: JFN0937
#@SOC: i.MX9131 
#@DESCRIPTION: Machine configuration for uSD image for MAS iMX91 JFN0937-CA01+OST000X1
#@MAINTAINER: Dario Scarpa <dario.scarpa@maselettronica.com>


IMX_DEFAULT_BSP             				= "nxp"
MACHINEOVERRIDES            				=. "use-${IMX_DEFAULT_BSP}-bsp:"
MACHINEOVERRIDES            				=. "mx91:"

require include/imx91-mas-jfn0937.inc

# BOOTLOADER
UBOOT_SRCBRANCH             				= "imx91-JFN0937-CA01-dev-ds"
UBOOT_SRCREV                				= "b0ad80fce71f046a560d38c7afb3318e02ef361b"
UBOOT_DEVICETREE_BASENAME   				= "imx91-jfn0937"
UBOOT_CONFIG_BASENAME       				= "imx91_jfn0937"
UBOOT_DTB_NAME              				= "${UBOOT_DEVICETREE_BASENAME}.dtb"
UBOOT_CONFIG              					??= "sd"
UBOOT_CONFIG[sd]            				= "${UBOOT_CONFIG_BASENAME}_defconfig,sdcard"

# KERNEL
KERNEL_SRCBRANCH            				= "imx91-jfn0937-dev-ds"
KERNEL_SRCREV               				= "3a0db2acb170afa2ab41f5e8485d534d74ccdf6d"
KERNEL_DEVICETREE_BASENAME  				= "imx91-jfn0937"
KERNEL_DEVICETREE           				= "freescale/${KERNEL_DEVICETREE_BASENAME}.dtb"
KERNEL_DEFCONFIG            				= "imx91_jfn0937_defconfig"

# Set DDR FIRMWARE
DDR_FIRMWARE_VERSION        				= "202201"
DDR_FIRMWARE_NAME           				= " \
												lpddr4_dmem_1d_v${DDR_FIRMWARE_VERSION}.bin \
												lpddr4_dmem_2d_v${DDR_FIRMWARE_VERSION}.bin \
												lpddr4_imem_1d_v${DDR_FIRMWARE_VERSION}.bin \
												lpddr4_imem_2d_v${DDR_FIRMWARE_VERSION}.bin \
"

# MAS MK-IMAGE
MASMKIMAGE_SRCBRANCH      					= "iMX91-JFN0937-dev-ds"
MASMKIMAGE_SRCREV         					= "efb72d630c67d31faabc713ff8b12b7d2309819f"

# MAS TEST-SUITE
MASTESTSUITE_SRCBRANCH      				= "imx91-jfn0937-dev-ds"
MASTESTSUITE_SRCREV         				= "74d6041a3dab98df9f5689c64c120a89e329bcf8"

# PREFERRED PROVIDERS
IMX_DEFAULT_BOOTLOADER:use-nxp-bsp          = "u-boot-mas-imx"
IMX_DEFAULT_BOOTLOADER:use-mainline-bsp     = "u-boot-fslc"
IMX_DEFAULT_ATF_PROVIDER                  	??= "mas-imx-atf"
IMX_DEFAULT_KERNEL:use-nxp-bsp    			= "linux-mas-imx"
IMX_DEFAULT_KERNEL:imx-nxp-bsp     			= "linux-imx"
PREFERRED_PROVIDER_u-boot                 	??= "${IMX_DEFAULT_BOOTLOADER}"
PREFERRED_PROVIDER_virtual/bootloader       = "${IMX_DEFAULT_BOOTLOADER}"
PREFERRED_PROVIDER_virtual/kernel           = "${IMX_DEFAULT_KERNEL}"


# SECO FIRMWARE
SECO_FIRMWARE_NAME							= "mx91a0-ahab-container.img"

# WIC image conf file
SOC_DEFAULT_WKS_FILE        				= "mas-default-dev-usd.wks.in"


# values: [usd, emmc, prod] select the build type for overwrite the correct fstab file
BUILD_TYPE                  				= "usd"

#if lcd display is used set here the resolution
DISPLAY_RESOLUTION 							= "1024x600"
```

## conf/machine/imx93-jfn0937-aa06aa0-emmc.conf
```bitbake
#@TYPE: Machine
#@NAME: JFN0937-AA06AA1 
#@SOC: i.MX9352 
#@DESCRIPTION:	Machine configuration for uSD image for OSM JFN0937-AA06AA1 board on OST000X1 carrier board
#				RAM: 2GB LPDDR4X Alliance Memory AS4C1G16MD4V-046BIN
#					 2GB LPDDR4X Alliance Memory AS4C1G16MD4VA-046BIN
#@MAINTAINER: Dario Scarpa <dario.scarpa@maselettronica.com>


IMX_DEFAULT_BSP             				= "nxp"
MACHINEOVERRIDES            				=. "use-${IMX_DEFAULT_BSP}-bsp:"
MACHINEOVERRIDES            				=. "mx93:"
MACHINEOVERRIDES            				=. "ailux:"

require include/imx93-mas-nei000x.inc

# BOOTLOADER
UBOOT_SRCBRANCH             				= "imx93-jfn0937-aa06aa0"
UBOOT_SRCREV                				= "d23c68a04f646a53b492fd862515a4ec0a9f610d"
UBOOT_DEVICETREE_BASENAME   				= "imx93-ost000x1"
UBOOT_CONFIG_BASENAME       				= "imx93_ost000x1"
UBOOT_DTB_NAME              				= "${UBOOT_DEVICETREE_BASENAME}.dtb"
UBOOT_CONFIG              					??= "emmc"
UBOOT_CONFIG[emmc]            				= "${UBOOT_CONFIG_BASENAME}_v2_emmc_defconfig,sdcard"

# KERNEL
KERNEL_SRCBRANCH            				= "imx93-ost000x1-dev-ds"
KERNEL_SRCREV               				= "9ccac4cce2d0b9de5f0892560e8cd7af6ec12db8"
KERNEL_DEVICETREE_BASENAME  				= "imx93-ost000x1"
KERNEL_DEVICETREE           				= "freescale/${KERNEL_DEVICETREE_BASENAME}.dtb"
KERNEL_DEFCONFIG            				= "imx93_ost000x1_v2_defconfig"

# Set DDR FIRMWARE
DDR_FIRMWARE_VERSION        				= "202201"
DDR_FIRMWARE_NAME           				= " \
												lpddr4_dmem_1d_v${DDR_FIRMWARE_VERSION}.bin \
												lpddr4_dmem_2d_v${DDR_FIRMWARE_VERSION}.bin \
												lpddr4_imem_1d_v${DDR_FIRMWARE_VERSION}.bin \
												lpddr4_imem_2d_v${DDR_FIRMWARE_VERSION}.bin \
"

# MAS MK-IMAGE
MASMKIMAGE_SRCBRANCH      					= "iMX93-OST000X1-dev-ds"
MASMKIMAGE_SRCREV         					= "b0d6a5fa2c5d72727d89c410ffcce5592e977e5d"

# MAS TEST-SUITE
MASTESTSUITE_SRCBRANCH      				= "iMX93-OST000X1-dev-ds"
MASTESTSUITE_SRCREV         				= "fd79a748dc6edfe9e27fea3dc3243654833568b9"

# PREFERRED PROVIDERS
IMX_DEFAULT_BOOTLOADER:use-nxp-bsp          = "u-boot-mas-imx"
IMX_DEFAULT_BOOTLOADER:use-mainline-bsp     = "u-boot-fslc"
IMX_DEFAULT_ATF_PROVIDER                  	??= "mas-imx-atf"
IMX_DEFAULT_KERNEL:use-nxp-bsp    			= "linux-mas-imx"
IMX_DEFAULT_KERNEL:imx-nxp-bsp     			= "linux-imx"
PREFERRED_PROVIDER_u-boot                 	??= "${IMX_DEFAULT_BOOTLOADER}"
PREFERRED_PROVIDER_virtual/bootloader       = "${IMX_DEFAULT_BOOTLOADER}"
PREFERRED_PROVIDER_virtual/kernel           = "${IMX_DEFAULT_KERNEL}"


# SECO FIRMWARE
SECO_FIRMWARE_NAME							= "mx93a1-ahab-container.img"

# WIC image conf file
SOC_DEFAULT_WKS_FILE        				= "ost000x-dev-usd.wks.in"


# values: [usd, emmc, prod] select the build type for overwrite the correct fstab file
BUILD_TYPE                  				= "emmc"

#if lcd display is used set here the resolution
DISPLAY_RESOLUTION 							= "1024x600"
```

## conf/machine/imx93-jfn0937-aa06aa0-usd.conf
```bitbake
#@TYPE: Machine
#@NAME: JFN0937-AA06AA0 
#@SOC: i.MX9352 
#@DESCRIPTION:	Machine configuration for uSD image for OSM JFN0937-AA06AA0/AA06AB0 board on OST000X1 carrier board
#				RAM: 2GB LPDDR4X Micron MT53E1G16D1ZW-046	(AA06AA0)
#					 2GB LPDDR4X Intelligent Memory IMAG16L4KBBG-046I	(AA06AB0)
#@MAINTAINER: Dario Scarpa <dario.scarpa@maselettronica.com>


IMX_DEFAULT_BSP             				= "nxp"
MACHINEOVERRIDES            				=. "use-${IMX_DEFAULT_BSP}-bsp:"
MACHINEOVERRIDES            				=. "mx93:"
MACHINEOVERRIDES            				=. "ailux:"

require include/imx93-mas-nei000x.inc

# BOOTLOADER
UBOOT_SRCBRANCH             				= "imx93-neith-aa06aa0"
UBOOT_SRCREV                				= "d23c68a04f646a53b492fd862515a4ec0a9f610d"
UBOOT_DEVICETREE_BASENAME   				= "imx93-ost000x1"
UBOOT_CONFIG_BASENAME       				= "imx93_ost000x1"
UBOOT_DTB_NAME              				= "${UBOOT_DEVICETREE_BASENAME}.dtb"
UBOOT_CONFIG              					??= "sd"
UBOOT_CONFIG[sd]            				= "${UBOOT_CONFIG_BASENAME}_v2_defconfig,sdcard"

# KERNEL
KERNEL_SRCBRANCH            				= "imx93-neith-6.6.y"
KERNEL_SRCREV               				= "89405b0a5463d178f94124f96e7a0db6d9549c0c"
KERNEL_DEVICETREE_BASENAME  				= "imx93-ost000x1"
KERNEL_DEVICETREE           				= "freescale/${KERNEL_DEVICETREE_BASENAME}.dtb"
KERNEL_DEFCONFIG            				= "imx93_ost000x1_v2_defconfig"

# Set DDR FIRMWARE
DDR_FIRMWARE_VERSION        				= "202201"
DDR_FIRMWARE_NAME           				= " \
												lpddr4_dmem_1d_v${DDR_FIRMWARE_VERSION}.bin \
												lpddr4_dmem_2d_v${DDR_FIRMWARE_VERSION}.bin \
												lpddr4_imem_1d_v${DDR_FIRMWARE_VERSION}.bin \
												lpddr4_imem_2d_v${DDR_FIRMWARE_VERSION}.bin \
"

# MAS MK-IMAGE
MASMKIMAGE_SRCBRANCH      					= "iMX9-OSM-scarthgap"
MASMKIMAGE_SRCREV         					= "1ef42fc6604758d2d80dac12537f5b4f0737f59a"

# MAS TEST-SUITE
MASTESTSUITE_SRCBRANCH      				= "iMX93-NEITH-scarthgap"
MASTESTSUITE_SRCREV         				= "9d84d007c621f9b762d777ae42152d580348aaab"

# PREFERRED PROVIDERS
IMX_DEFAULT_BOOTLOADER:use-nxp-bsp          = "u-boot-mas-imx"
IMX_DEFAULT_BOOTLOADER:use-mainline-bsp     = "u-boot-fslc"
IMX_DEFAULT_ATF_PROVIDER                  	??= "imx-atf"
IMX_DEFAULT_KERNEL:use-nxp-bsp    			= "linux-mas-imx"
IMX_DEFAULT_KERNEL:imx-nxp-bsp     			= "linux-imx"
PREFERRED_PROVIDER_u-boot                 	??= "${IMX_DEFAULT_BOOTLOADER}"
PREFERRED_PROVIDER_virtual/bootloader       = "${IMX_DEFAULT_BOOTLOADER}"
PREFERRED_PROVIDER_virtual/kernel           = "${IMX_DEFAULT_KERNEL}"


# SECO FIRMWARE
SECO_FIRMWARE_NAME							= "mx93a1-ahab-container.img"

# WIC image conf file
SOC_DEFAULT_WKS_FILE        				= "nei000x0-dev-usd.wks.in"


# values: [usd, emmc, prod] select the build type for overwrite the correct fstab file
BUILD_TYPE                  				= "usd"

#if lcd display is used set here the resolution
DISPLAY_RESOLUTION 							= "1024x600"
```

## conf/machine/imx93-jfn0937-aa06aa1-usd.conf
```bitbake
#@TYPE: Machine
#@NAME: JFN0937-AA06AA1 
#@SOC: i.MX9352 
#@DESCRIPTION:	Machine configuration for uSD image for OSM JFN0937-AA06AA1 board on OST000X1 carrier board
#				RAM: 2GB LPDDR4X Alliance Memory AS4C1G16MD4V-046BIN
#					 2GB LPDDR4X Alliance Memory AS4C1G16MD4VA-046BIN
#@MAINTAINER: Dario Scarpa <dario.scarpa@maselettronica.com>


IMX_DEFAULT_BSP             				= "nxp"
MACHINEOVERRIDES            				=. "use-${IMX_DEFAULT_BSP}-bsp:"
MACHINEOVERRIDES            				=. "mx93:"

require include/imx93-mas-nei000x.inc

# BOOTLOADER
UBOOT_SRCBRANCH             				= "imx93-jfn0937-aa06aa1"
UBOOT_SRCREV                				= "5708324e19b4e2c2a3c297f8f9c341e222bf992e"
UBOOT_DEVICETREE_BASENAME   				= "imx93-ost000x1"
UBOOT_CONFIG_BASENAME       				= "imx93_ost000x1"
UBOOT_DTB_NAME              				= "${UBOOT_DEVICETREE_BASENAME}.dtb"
UBOOT_CONFIG              					??= "sd"
UBOOT_CONFIG[sd]            				= "${UBOOT_CONFIG_BASENAME}_defconfig,sdcard"

# KERNEL
KERNEL_SRCBRANCH            				= "imx93-ost000x1-dev-ds"
KERNEL_SRCREV               				= "eb4d5038b23eb3ae102d26840cab68f7e6a55f85"
KERNEL_DEVICETREE_BASENAME  				= "imx93-ost000x1"
KERNEL_DEVICETREE           				= "freescale/${KERNEL_DEVICETREE_BASENAME}.dtb"
KERNEL_DEFCONFIG            				= "imx93_ost000x1_defconfig"

# Set DDR FIRMWARE
DDR_FIRMWARE_VERSION        				= "202201"
DDR_FIRMWARE_NAME           				= " \
												lpddr4_dmem_1d_v${DDR_FIRMWARE_VERSION}.bin \
												lpddr4_dmem_2d_v${DDR_FIRMWARE_VERSION}.bin \
												lpddr4_imem_1d_v${DDR_FIRMWARE_VERSION}.bin \
												lpddr4_imem_2d_v${DDR_FIRMWARE_VERSION}.bin \
"

# MAS MK-IMAGE
MASMKIMAGE_SRCBRANCH      					= "iMX93-NEI000X0-dev-ds"
MASMKIMAGE_SRCREV         					= "db638f857fb01c52862cd0d287ee29e38f84e609"

# MAS TEST-SUITE
MASTESTSUITE_SRCBRANCH      				= "iMX93-OST000X1-dev-ds"
MASTESTSUITE_SRCREV         				= "fd79a748dc6edfe9e27fea3dc3243654833568b9"

# PREFERRED PROVIDERS
IMX_DEFAULT_BOOTLOADER:use-nxp-bsp          = "u-boot-mas-imx"
IMX_DEFAULT_BOOTLOADER:use-mainline-bsp     = "u-boot-fslc"
IMX_DEFAULT_ATF_PROVIDER                  	??= "mas-imx-atf"
IMX_DEFAULT_KERNEL:use-nxp-bsp    			= "linux-mas-imx"
IMX_DEFAULT_KERNEL:imx-nxp-bsp     			= "linux-imx"
PREFERRED_PROVIDER_u-boot                 	??= "${IMX_DEFAULT_BOOTLOADER}"
PREFERRED_PROVIDER_virtual/bootloader       = "${IMX_DEFAULT_BOOTLOADER}"
PREFERRED_PROVIDER_virtual/kernel           = "${IMX_DEFAULT_KERNEL}"


# SECO FIRMWARE
SECO_FIRMWARE_NAME							= "mx93a1-ahab-container.img"

# WIC image conf file
SOC_DEFAULT_WKS_FILE        				= "nei000x0-dev-usd.wks.in"


# values: [usd, emmc, prod] select the build type for overwrite the correct fstab file
BUILD_TYPE                  				= "usd"

#if lcd display is used set here the resolution
DISPLAY_RESOLUTION 							= "1024x600"
```

## conf/machine/imx93-nei000x0-usd.conf
```bitbake
#@TYPE: Machine
#@NAME: NEITH000x0  
#@SOC: i.MX9352 
#@DESCRIPTION: Machine configuration for uSD image for MAS iMX93 NEITH000X0 board
#@MAINTAINER: Dario Scarpa <dario.scarpa@maselettronica.com>


IMX_DEFAULT_BSP             				= "nxp"
MACHINEOVERRIDES            				=. "use-${IMX_DEFAULT_BSP}-bsp:"
MACHINEOVERRIDES            				=. "mx93:"

require include/imx93-mas-nei000x.inc

# BOOTLOADER
UBOOT_SRCBRANCH             				= "iMX93-NEI000X0-dev-ds"
UBOOT_SRCREV                				= "a9a3ea44de79db98894b5c85f32aa39a8298d19e"
UBOOT_DEVICETREE_BASENAME   				= "imx93-nei000x0"
UBOOT_CONFIG_BASENAME       				= "imx93_nei000x0"
UBOOT_DTB_NAME              				= "${UBOOT_DEVICETREE_BASENAME}.dtb"
UBOOT_CONFIG              					??= "sd"
UBOOT_CONFIG[sd]            				= "${UBOOT_CONFIG_BASENAME}_defconfig,sdcard"

# KERNEL
KERNEL_SRCBRANCH            				= "iMX93-NEI000X0-dev-ds"
KERNEL_SRCREV               				= "d331923bff720114b11cf88461e04a6ed211fcdc"
KERNEL_DEVICETREE_BASENAME  				= "imx93-nei000x0"
KERNEL_DEVICETREE           				= "freescale/${KERNEL_DEVICETREE_BASENAME}.dtb"
KERNEL_DEFCONFIG            				= "imx93_nei000x0_defconfig"

# Set DDR FIRMWARE
DDR_FIRMWARE_VERSION        				= "202201"
DDR_FIRMWARE_NAME           				= " \
												lpddr4_dmem_1d_v${DDR_FIRMWARE_VERSION}.bin \
												lpddr4_dmem_2d_v${DDR_FIRMWARE_VERSION}.bin \
												lpddr4_imem_1d_v${DDR_FIRMWARE_VERSION}.bin \
												lpddr4_imem_2d_v${DDR_FIRMWARE_VERSION}.bin \
"

# MAS MK-IMAGE
MASMKIMAGE_SRCBRANCH      					= "iMX93-NEI000X0-dev-ds"
MASMKIMAGE_SRCREV         					= "db638f857fb01c52862cd0d287ee29e38f84e609"

# MAS TEST-SUITE
MASTESTSUITE_SRCBRANCH      				= "iMX93-NEI000X0-dev-ds"
MASTESTSUITE_SRCREV         				= "3e03c370229b9b2aeafa9d6b7332f768fa492cde"

# PREFERRED PROVIDERS
IMX_DEFAULT_BOOTLOADER:use-nxp-bsp          = "u-boot-mas-imx"
IMX_DEFAULT_BOOTLOADER:use-mainline-bsp     = "u-boot-fslc"
IMX_DEFAULT_ATF_PROVIDER                  	??= "mas-imx-atf"
IMX_DEFAULT_KERNEL:use-nxp-bsp    			= "linux-mas-imx"
IMX_DEFAULT_KERNEL:imx-nxp-bsp     			= "linux-imx"
PREFERRED_PROVIDER_u-boot                 	??= "${IMX_DEFAULT_BOOTLOADER}"
PREFERRED_PROVIDER_virtual/bootloader       = "${IMX_DEFAULT_BOOTLOADER}"
PREFERRED_PROVIDER_virtual/kernel           = "${IMX_DEFAULT_KERNEL}"


# SECO FIRMWARE
SECO_FIRMWARE_NAME							= "mx93a1-ahab-container.img"

# WIC image conf file
SOC_DEFAULT_WKS_FILE        				= "nei000x0-dev-usd.wks.in"


# values: [usd, emmc, prod] select the build type for overwrite the correct fstab file
BUILD_TYPE                  				= "usd"

#if lcd display is used set here the resolution
DISPLAY_RESOLUTION 							= "1024x600"
```
