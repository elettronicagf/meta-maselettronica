## conf/machine/imx93-ost000x0-emmc.conf
```bitbake
#@TYPE: Machine
#@NAME: NEITH000x0  
#@SOC: i.MX9352 
#@DESCRIPTION: Machine configuration for eMMC image for MAS iMX93 NEITH000X0 board
#@MAINTAINER: Dario Scarpa <dario.scarpa@maselettronica.com>


IMX_DEFAULT_BSP             				= "nxp"
MACHINEOVERRIDES            				=. "use-${IMX_DEFAULT_BSP}-bsp:"
MACHINEOVERRIDES            				=. "mx93:"

require include/imx93-mas-nei000x.inc

# BOOTLOADER
UBOOT_SRCBRANCH             				= "imx93-nei000x0-dev-ds"
UBOOT_SRCREV                				= "90ae6b28318adec51a66ab32f58b9e0010109ef1"
UBOOT_DEVICETREE_BASENAME   				= "imx93-ost000x0"
UBOOT_CONFIG_BASENAME       				= "imx93_ost000x0"
UBOOT_DTB_NAME              				= "${UBOOT_DEVICETREE_BASENAME}.dtb"
UBOOT_CONFIG              					??= "emmc"
UBOOT_CONFIG[emmc]            				= "${UBOOT_CONFIG_BASENAME}_emmc_defconfig,sdcard"

# KERNEL
KERNEL_SRCBRANCH            				= "imx93-nei000x0-dev-ds"
KERNEL_SRCREV               				= "e3403ff15c5fa3910e24ccefeced262100ef8587"
KERNEL_DEVICETREE_BASENAME  				= "imx93-ost000x0"
KERNEL_DEVICETREE           				= "freescale/${KERNEL_DEVICETREE_BASENAME}.dtb"
KERNEL_DEFCONFIG            				= "imx93_ost000x0_defconfig"

# Set DDR FIRMWARE
DDR_FIRMWARE_VERSION        				= "202201"
DDR_FIRMWARE_NAME           				= " \
												lpddr4_dmem_1d_v${DDR_FIRMWARE_VERSION}.bin \
												lpddr4_dmem_2d_v${DDR_FIRMWARE_VERSION}.bin \
												lpddr4_imem_1d_v${DDR_FIRMWARE_VERSION}.bin \
												lpddr4_imem_2d_v${DDR_FIRMWARE_VERSION}.bin \
"

# MAS MK-IMAGE
MASMKIMAGE_SRCBRANCH      					= "iMX93-NEI000X0-dev-ds"
MASMKIMAGE_SRCREV         					= "db638f857fb01c52862cd0d287ee29e38f84e609"

# MAS TEST-SUITE
MASTESTSUITE_SRCBRANCH      				= "iMX93-OST000X0-dev-ds"
MASTESTSUITE_SRCREV         				= "021b7b5eb8c124827818f9afa8a598403f45e604"

# PREFERRED PROVIDERS
IMX_DEFAULT_BOOTLOADER:use-nxp-bsp          = "u-boot-mas-imx"
IMX_DEFAULT_BOOTLOADER:use-mainline-bsp     = "u-boot-fslc"
IMX_DEFAULT_ATF_PROVIDER                  	??= "mas-imx-atf"
IMX_DEFAULT_KERNEL:use-nxp-bsp    			= "linux-mas-imx"
IMX_DEFAULT_KERNEL:imx-nxp-bsp     			= "linux-imx"
PREFERRED_PROVIDER_u-boot                 	??= "${IMX_DEFAULT_BOOTLOADER}"
PREFERRED_PROVIDER_virtual/bootloader       = "${IMX_DEFAULT_BOOTLOADER}"
PREFERRED_PROVIDER_virtual/kernel           = "${IMX_DEFAULT_KERNEL}"


# SECO FIRMWARE
SECO_FIRMWARE_NAME							= "mx93a1-ahab-container.img"

# WIC image conf file
SOC_DEFAULT_WKS_FILE        				= "nei000x0-dev-usd.wks.in"


# values: [usd, emmc, prod] select the build type for overwrite the correct fstab file
BUILD_TYPE                  				= "emmc"

#if lcd display is used set here the resolution
DISPLAY_RESOLUTION 							= "1024x600"
```

## conf/machine/imx93-ost000x0-usd.conf
```bitbake
#@TYPE: Machine
#@NAME: OST000x0  
#@SOC: i.MX9352 
#@DESCRIPTION: Machine configuration for uSD image for MAS iMX93 OST000X0 OSM test board
#@MAINTAINER: Dario Scarpa <dario.scarpa@maselettronica.com>


IMX_DEFAULT_BSP             				= "nxp"
MACHINEOVERRIDES            				=. "use-${IMX_DEFAULT_BSP}-bsp:"
MACHINEOVERRIDES            				=. "mx93:"

require include/imx93-mas-nei000x.inc

# BOOTLOADER
UBOOT_SRCBRANCH             				= "imx93-nei000x0-dev-ds"
UBOOT_SRCREV                				= "f36bff189dd4d520bc5a37f1562e1fcb0eb2dec8"
UBOOT_DEVICETREE_BASENAME   				= "imx93-ost000x0"
UBOOT_CONFIG_BASENAME       				= "imx93_ost000x0"
UBOOT_DTB_NAME              				= "${UBOOT_DEVICETREE_BASENAME}.dtb"
UBOOT_CONFIG              					??= "sd"
UBOOT_CONFIG[sd]            				= "${UBOOT_CONFIG_BASENAME}_defconfig,sdcard"

# KERNEL
KERNEL_SRCBRANCH            				= "imx93-nei000x0-dev-ds"
KERNEL_SRCREV               				= "c3abac197e00a46e3c3a8cee878b9b776d349ca0"
KERNEL_DEVICETREE_BASENAME  				= "imx93-ost000x0"
KERNEL_DEVICETREE           				= "freescale/${KERNEL_DEVICETREE_BASENAME}.dtb"
KERNEL_DEFCONFIG            				= "imx93_ost000x0_defconfig"

# Set DDR FIRMWARE
DDR_FIRMWARE_VERSION        				= "202201"
DDR_FIRMWARE_NAME           				= " \
												lpddr4_dmem_1d_v${DDR_FIRMWARE_VERSION}.bin \
												lpddr4_dmem_2d_v${DDR_FIRMWARE_VERSION}.bin \
												lpddr4_imem_1d_v${DDR_FIRMWARE_VERSION}.bin \
												lpddr4_imem_2d_v${DDR_FIRMWARE_VERSION}.bin \
"

# MAS MK-IMAGE
MASMKIMAGE_SRCBRANCH      					= "iMX93-NEI000X0-dev-ds"
MASMKIMAGE_SRCREV         					= "db638f857fb01c52862cd0d287ee29e38f84e609"

# MAS TEST-SUITE
MASTESTSUITE_SRCBRANCH      				= "iMX93-OST000X0-dev-ds"
MASTESTSUITE_SRCREV         				= "021b7b5eb8c124827818f9afa8a598403f45e604"

# PREFERRED PROVIDERS
IMX_DEFAULT_BOOTLOADER:use-nxp-bsp          = "u-boot-mas-imx"
IMX_DEFAULT_BOOTLOADER:use-mainline-bsp     = "u-boot-fslc"
IMX_DEFAULT_ATF_PROVIDER                  	??= "mas-imx-atf"
IMX_DEFAULT_KERNEL:use-nxp-bsp    			= "linux-mas-imx"
IMX_DEFAULT_KERNEL:imx-nxp-bsp     			= "linux-imx"
PREFERRED_PROVIDER_u-boot                 	??= "${IMX_DEFAULT_BOOTLOADER}"
PREFERRED_PROVIDER_virtual/bootloader       = "${IMX_DEFAULT_BOOTLOADER}"
PREFERRED_PROVIDER_virtual/kernel           = "${IMX_DEFAULT_KERNEL}"


# SECO FIRMWARE
SECO_FIRMWARE_NAME							= "mx93a1-ahab-container.img"

# WIC image conf file
SOC_DEFAULT_WKS_FILE        				= "nei000x0-dev-usd.wks.in"


# values: [usd, emmc, prod] select the build type for overwrite the correct fstab file
BUILD_TYPE                  				= "usd"

#if lcd display is used set here the resolution
DISPLAY_RESOLUTION 							= "1024x600"
```

## conf/machine/imx93-ost000x1-usd.conf
```bitbake
#@TYPE: Machine
#@NAME: OST000x1
#@SOC: i.MX9352 
#@DESCRIPTION: Machine configuration for uSD image for MAS iMX93 OST000X1 OSM-Rev2 test board
#@MAINTAINER: Dario Scarpa <dario.scarpa@maselettronica.com>


IMX_DEFAULT_BSP             				= "nxp"
MACHINEOVERRIDES            				=. "use-${IMX_DEFAULT_BSP}-bsp:"
MACHINEOVERRIDES            				=. "mx93:"
MACHINEOVERRIDES							=. "ailux:"

require include/imx93-mas-nei000x.inc

# BOOTLOADER
UBOOT_SRCBRANCH             				= "imx93-ost000x1-dev-ds"
UBOOT_SRCREV                				= "c6e344061e1db2691b03cc4980d6f6461ca4855f"
UBOOT_DEVICETREE_BASENAME   				= "imx93-ost000x1"
UBOOT_CONFIG_BASENAME       				= "imx93_ost000x1"
UBOOT_DTB_NAME              				= "${UBOOT_DEVICETREE_BASENAME}.dtb"
UBOOT_CONFIG              					??= "sd"
UBOOT_CONFIG[sd]            				= "${UBOOT_CONFIG_BASENAME}_defconfig,sdcard"

# KERNEL
KERNEL_SRCBRANCH            				= "imx93-ost000x1-dev-ds"
KERNEL_SRCREV               				= "97e01a20372fea5418f01ddcf65ab3ccb4d77954"
KERNEL_DEVICETREE_BASENAME  				= "imx93-ost000x1"
KERNEL_DEVICETREE           				= "freescale/${KERNEL_DEVICETREE_BASENAME}.dtb"
KERNEL_DEFCONFIG            				= "imx93_ost000x1_v2_defconfig"

# Set DDR FIRMWARE
DDR_FIRMWARE_VERSION        				= "202201"
DDR_FIRMWARE_NAME           				= " \
												lpddr4_dmem_1d_v${DDR_FIRMWARE_VERSION}.bin \
												lpddr4_dmem_2d_v${DDR_FIRMWARE_VERSION}.bin \
												lpddr4_imem_1d_v${DDR_FIRMWARE_VERSION}.bin \
												lpddr4_imem_2d_v${DDR_FIRMWARE_VERSION}.bin \
"

# MAS MK-IMAGE
MASMKIMAGE_SRCBRANCH      					= "iMX93-OST000X1-dev-ds"
MASMKIMAGE_SRCREV         					= "b0d6a5fa2c5d72727d89c410ffcce5592e977e5d"

# MAS TEST-SUITE
MASTESTSUITE_SRCBRANCH      				= "iMX93-OST000X1-dev-ds"
MASTESTSUITE_SRCREV         				= "fd79a748dc6edfe9e27fea3dc3243654833568b9"

# PREFERRED PROVIDERS
IMX_DEFAULT_BOOTLOADER:use-nxp-bsp          = "u-boot-mas-imx"
IMX_DEFAULT_BOOTLOADER:use-mainline-bsp     = "u-boot-fslc"
IMX_DEFAULT_ATF_PROVIDER                  	??= "mas-imx-atf"
IMX_DEFAULT_KERNEL:use-nxp-bsp    			= "linux-mas-imx"
IMX_DEFAULT_KERNEL:imx-nxp-bsp     			= "linux-imx"
PREFERRED_PROVIDER_u-boot                 	??= "${IMX_DEFAULT_BOOTLOADER}"
PREFERRED_PROVIDER_virtual/bootloader       = "${IMX_DEFAULT_BOOTLOADER}"
PREFERRED_PROVIDER_virtual/kernel           = "${IMX_DEFAULT_KERNEL}"


# SECO FIRMWARE
SECO_FIRMWARE_NAME							= "mx93a1-ahab-container.img"

# WIC image conf file
SOC_DEFAULT_WKS_FILE        				= "nei000x0-dev-usd.wks.in"


# values: [usd, emmc, prod] select the build type for overwrite the correct fstab file
BUILD_TYPE                  				= "usd"

#if lcd display is used set here the resolution
DISPLAY_RESOLUTION 							= "1024x600"
```

## conf/machine/imx93-ost001x0-usd.conf
```bitbake
#@TYPE: Machine
#@NAME: OST000x0  
#@SOC: i.MX9352 
#@DESCRIPTION: Machine configuration for uSD image for MAS iMX93 OST001X0 OSM-Rev1 test board
#@MAINTAINER: Dario Scarpa <dario.scarpa@maselettronica.com>


IMX_DEFAULT_BSP             				= "nxp"
MACHINEOVERRIDES            				=. "use-${IMX_DEFAULT_BSP}-bsp:"
MACHINEOVERRIDES            				=. "mx93:"

require include/imx93-mas-nei000x.inc

# BOOTLOADER
UBOOT_SRCBRANCH             				= "imx93-nei000x0-dev-ds"
UBOOT_SRCREV                				= "d4aa8309ab679549ad8a86061fa49b45bae66349"
UBOOT_DEVICETREE_BASENAME   				= "imx93-ost001x0"
UBOOT_CONFIG_BASENAME       				= "imx93_ost001x0"
UBOOT_DTB_NAME              				= "${UBOOT_DEVICETREE_BASENAME}.dtb"
UBOOT_CONFIG              					??= "sd"
UBOOT_CONFIG[sd]            				= "${UBOOT_CONFIG_BASENAME}_defconfig,sdcard"

# KERNEL
KERNEL_SRCBRANCH            				= "imx93-nei000x0-dev-ds"
KERNEL_SRCREV               				= "16c95151e99c230fb0d7635b4734c5e74cb092bd"
KERNEL_DEVICETREE_BASENAME  				= "imx93-ost001x0"
KERNEL_DEVICETREE           				= "freescale/${KERNEL_DEVICETREE_BASENAME}.dtb"
KERNEL_DEFCONFIG            				= "imx93_ost000x0_defconfig"

# Set DDR FIRMWARE
DDR_FIRMWARE_VERSION        				= "202201"
DDR_FIRMWARE_NAME           				= " \
												lpddr4_dmem_1d_v${DDR_FIRMWARE_VERSION}.bin \
												lpddr4_dmem_2d_v${DDR_FIRMWARE_VERSION}.bin \
												lpddr4_imem_1d_v${DDR_FIRMWARE_VERSION}.bin \
												lpddr4_imem_2d_v${DDR_FIRMWARE_VERSION}.bin \
"

# MAS MK-IMAGE
MASMKIMAGE_SRCBRANCH      					= "iMX93-OST001X0-dev-ds"
MASMKIMAGE_SRCREV         					= "cf9a1f07a95e661c956829c5e07e92f3f5f11aa2"

# MAS TEST-SUITE
MASTESTSUITE_SRCBRANCH      				= "iMX93-OST000X0-dev-ds"
MASTESTSUITE_SRCREV         				= "79c847e1697d9ba87fb4c7f81462353c8312dd7b"

# PREFERRED PROVIDERS
IMX_DEFAULT_BOOTLOADER:use-nxp-bsp          = "u-boot-mas-imx"
IMX_DEFAULT_BOOTLOADER:use-mainline-bsp     = "u-boot-fslc"
IMX_DEFAULT_ATF_PROVIDER                  	??= "mas-imx-atf"
IMX_DEFAULT_KERNEL:use-nxp-bsp    			= "linux-mas-imx"
IMX_DEFAULT_KERNEL:imx-nxp-bsp     			= "linux-imx"
PREFERRED_PROVIDER_u-boot                 	??= "${IMX_DEFAULT_BOOTLOADER}"
PREFERRED_PROVIDER_virtual/bootloader       = "${IMX_DEFAULT_BOOTLOADER}"
PREFERRED_PROVIDER_virtual/kernel           = "${IMX_DEFAULT_KERNEL}"


# SECO FIRMWARE
SECO_FIRMWARE_NAME							= "mx93a1-ahab-container.img"

# WIC image conf file
SOC_DEFAULT_WKS_FILE        				= "nei000x0-dev-usd.wks.in"


# values: [usd, emmc, prod] select the build type for overwrite the correct fstab file
BUILD_TYPE                  				= "usd"

#if lcd display is used set here the resolution
DISPLAY_RESOLUTION 							= "1024x600"
```

## conf/machine/include/imx93-mas-nei000x.inc
```bitbake
require conf/machine/include/imx-mas-base.inc
require conf/machine/include/arm/armv8-2a/tune-cortexa55.inc

#IMX_DEFAULT_BOOTLOADER:use-nxp-bsp = "u-boot-imx"
#IMX_DEFAULT_BOOTLOADER:use-mainline-bsp = "u-boot-fslc"

LOADADDR = ""
UBOOT_SUFFIX = "bin"
UBOOT_MAKE_TARGET = ""

SPL_BINARY = "spl/u-boot-spl.bin"

# Set ATF platform name
ATF_PLATFORM = "imx93"

IMXBOOT_TARGETS = "flash_singleboot"

IMX_BOOT_SOC_TARGET = "iMX9"
IMX_BOOT_SEEK = "32"

# We have to disable SERIAL_CONSOLE due to auto-serial-console
SERIAL_CONSOLES = "115200;ttyLP0"

IMX_DEFAULT_BSP = "nxp"

MACHINE_FEATURES = "usbgadget usbhost vfat touchscreen"
MACHINE_FEATURES:append:use-nxp-bsp = " optee jailhouse"
MACHINE_FEATURES:remove:ailux = " bluetooth optee jailhouse touchscreen wifi"
```

## meta-distromas/conf/distro/mas-imx-xwayland.conf
```bitbake
# i.MX MAS minimal DISTRO

include conf/distro/include/mas-imx-base.inc
include conf/distro/include/fsl-imx-preferred-env.inc

# distro info
DISTRO 								= "mas-imx-xwayland"
DISTRO_NAME 						= "MAS i.MX Release Distro"
DISTRO_VERSION 						= "6.6.52-scarthgap"
DISTROOVERRIDES 					= "fsl"

# distro features
DISTRO_FEATURES:append 				= " opengl x11 wayland pam" 
DISTRO_FEATURES:append:mx8-nxp-bsp 	= " virtualization"

# removed features
DISTRO_FEATURES:remove 				= " directfb pulseaudio"
DISTRO_FEATURES:remove:mx93-nxp-bsp = " bluetooth bluez5"
DISTRO_FEATURES:remove:ailux 		= " x11 wayland 3g"


#PACKAGECONFIG:append:pn-weston      = " rdp"
#PACKAGECONFIG:append:pn-weston-init = " rdp"
```
